## Kconfig
```kconfig
#
#       Kconfig
#       Kernel architecture, devices, subsystems and boot configuration
#
#       2026/9/30 By JiTianYu391
#       Copyright (C) 2026 ViudiraTech.
#

mainmenu "SpaceKernel configuration"

menu "Target Platform & Build"

choice
    prompt "Target architecture"
    default ARCH_X86_64

config ARCH_X86_64
    bool "x86_64"

config ARCH_AARCH64
    bool "aarch64"

config ARCH_RISCV64
    bool "RISC-V 64"
endchoice

choice
    prompt "Build profile"
    default PROFILE_DEBUG

config PROFILE_DEBUG
    bool "Debug"

config PROFILE_RELEASE
    bool "Release"
endchoice

config KASLR
    bool "Enable Limine KASLR"
    default y
    help
      Ask Limine to randomize the position of the relocatable kernel and HHDM.

config KERNEL_CMDLINE
    string "Limine kernel command line"
    default "console=tty0 console=ttyS0"
    help
      Select the kernel console with console=ttyS0 or console=tty0..tty8.
      Multiple console= arguments enable multiple outputs.

endmenu

menu "Processor Architecture & SMP"

config SMP
    bool "Symmetric Multiprocessing (SMP) support"
    default y
    help
      Enable multi-core SMP bootstrap, per-CPU scheduler queues and IPIs.

config MAX_CPUS
    int "Maximum supported CPU count"
    depends on SMP
    range 1 256
    default 64
    help
      Maximum number of CPU cores tracked in SMP topology.

config RISCV_SV48
    bool "Use Sv48 instead of Sv39 on RISC-V"
    depends on ARCH_RISCV64
    default n
    help
      Sv39 uses three page-table levels and is the default for RV64.
      Enable this only on machines with Sv48 (4-level paging) support.

endmenu

menu "Device Drivers & Input Subsystem"

config PS2
    bool "PS/2 (i8042) controller and input subsystem"
    default y
    help
      Enable the i8042 PS/2 controller driver, dual-channel detection,
      keyboard and mouse input support.

config PS2_KEYBOARD
    bool "PS/2 Keyboard driver"
    depends on PS2
    default y
    help
      Enable PS/2 keyboard support with Scancode Set 1/2 translation,
      modifier key tracking, LED synchronization, and virtual console integration.

config PS2_MOUSE
    bool "PS/2 Mouse driver (IntelliMouse scroll wheel)"
    depends on PS2
    default y
    help
      Enable PS/2 mouse support with IntelliMouse 4-byte scroll wheel detection,
      packet sync alignment, and cursor coordinate tracking.

config SERIAL
    bool "Serial console driver (16550 / PL011)"
    default y
    help
      Enable standard serial port drivers for early and runtime console output.

config TTY
    bool "TTY virtual terminals and line discipline"
    default y
    help
      Enable terminal line discipline, raw/canonical input, and virtual consoles.

config FRAMEBUFFER
    bool "Limine Framebuffer graphics console"
    default y
    help
      Enable graphical framebuffer console rendering with Unicode font support.

config PCI
    bool "PCI / PCIe ECAM bus enumeration"
    default y
    help
      Enable PCIe ECAM config space discovery and device enumeration.

config BLOCK
    bool "Block device layer, LRU sector cache and MBR/GPT partitioning"
    default y
    help
      Enable the unified block device layer, LRU sector cache, RAMDisk,
      and automatic MBR/GPT partition table discovery.

config IDE
    bool "PCI IDE / PATA storage driver (Bus Master DMA + LBA28/48 PIO)"
    depends on BLOCK && PCI
    default y
    help
      Enable PCI IDE / PATA controller support with Bus Master PRDT DMA
      transfers and automatic LBA28/LBA48 PIO fallback.

config AHCI
    bool "PCI AHCI 1.0 SATA HBA driver (Command List / FIS / PRDT DMA)"
    depends on BLOCK && PCI
    default y
    help
      Enable AHCI 1.0 SATA Host Bus Adapter support using ABAR MMIO,
      Command Lists, H2D Register FIS, and PRDT DMA.

config NVME
    bool "PCIe NVMe 1.4 storage driver (Admin/IO Queue Pairs & PRP DMA)"
    depends on BLOCK && PCI
    default y
    help
      Enable PCIe NVMe controller and namespace support using Admin and I/O
      Submission/Completion Queue Pairs, Doorbells, and PRP DMA.

endmenu

menu "Kernel Features & Subsystems"

config VFS
    bool "Linux ABI Virtual File System (RamFS / DevFS / ProcFS)"
    default y
    help
      Enable the Linux 64-bit ABI compliant Virtual File System layer,
      per-task file descriptor tables, pipes, and virtual filesystems.

config FAT32
    bool "FAT32 (VFAT) filesystem driver with Long File Name (LFN) support"
    depends on VFS && BLOCK
    default y
    help
      Enable on-disk FAT32 filesystem mounting, formatting, cluster allocation,
      and VFAT Long File Name read/write support.

config EEVDF_SCHED
    bool "EEVDF preemptive fair scheduler"
    default y
    help
      Enable Earliest Eligible Virtual Deadline First (EEVDF) per-CPU scheduler.

config USER_SPACE
    bool "Linux ABI user space and ELF loader"
    default y
    help
      Enable isolated user virtual address spaces, Ring 3 / EL0 / U-mode privilege
      transitions, Linux ABI system calls, and 64-bit static ELF loading.

config KSHELL
    bool "Interactive kernel diagnostic shell (kshell)"
    default y
    help
      Enable the interactive kernel shell task on serial and foreground consoles.

endmenu

menu "Testing & QEMU Validation"

config BOOT_SELF_TEST
    bool "Run automated self-tests at boot"
    default n
    help
      Execute comprehensive smoke tests at boot: CPU/FPU, PMM/VMM/SLAB,
      SMP, EEVDF scheduler preemption/fairness, and user-mode Linux ABI self-tests.

config QEMU_CPUS
    int "QEMU virtual CPUs"
    range 1 64
    default 4
    help
      Number of virtual CPUs configured when launching QEMU.

config QEMU_MEMORY_MIB
    int "QEMU memory (MiB)"
    range 128 8192
    default 512
    help
      Amount of RAM allocated to the QEMU virtual machine in megabytes.

endmenu
```
